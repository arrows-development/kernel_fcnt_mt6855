## drivers/input/fingerprint/Kconfig
```kconfig
#
#Fingerprint
#
menu "Fingerprint support"
	depends on INPUT

config MTK_FINGERPRINT_SUPPORT
	tristate "Mediatek Fingerprint"
	default n
	help
	  Fingerprint mtk driver enable/disable
	  in the kernel.Say Y here if you want to
	  use mediatek fingerprint driver,fingerprint
	  driver will support fingerprint function

config MTK_FINGERPRINT_SELECT
	string "sensor type"
	default "FPC"

config FPC_FINGERPRINT
	tristate "FPC Fingerprint"
	default y
	help
	  FPC fingerprint FPC's device.

endmenu
```

## sound/soc/codecs/aw883xx/Kconfig
```kconfig
config SND_SOC_AW883XX
    tristate "SoC Audio for awinic aw883xx series"
    depends on I2C
    help
      This option enables support for aw883xx series Smart PA.
```
